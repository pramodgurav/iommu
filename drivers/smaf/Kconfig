## drivers/smaf/Kconfig
```kconfig
config SMAF
	tristate "Secure Memory Allocation Framework"
	depends on DMA_SHARED_BUFFER
	help
	  Choose this option to enable Secure Memory Allocation Framework

config SMAF_CMA
	tristate "SMAF CMA allocator"
	depends on SMAF
	help
	  Choose this option to enable CMA allocation within SMAF

config SMAF_TEST_SECURE
	tristate "SMAF secure module for test"
	depends on SMAF
	help
	  Choose this option to enable secure module for test purpose
```
